## firmware/boot/loader/sdkconfig.defaults
```kconfig
CONFIG_IDF_TARGET="esp32s31"
CONFIG_PARTITION_TABLE_CUSTOM=y
CONFIG_PARTITION_TABLE_CUSTOM_FILENAME="partitions.csv"
CONFIG_PARTITION_TABLE_OFFSET=0x8000
CONFIG_ESPTOOLPY_FLASHMODE_DIO=y
CONFIG_ESPTOOLPY_FLASHFREQ_80M=y
CONFIG_ESPTOOLPY_FLASHSIZE_16MB=y
CONFIG_BOOTLOADER_LOG_LEVEL_NONE=y
CONFIG_BOOTLOADER_APP_ROLLBACK_ENABLE=n
CONFIG_BOOTLOADER_SKIP_VALIDATE_IN_DEEP_SLEEP=n
CONFIG_BOOTLOADER_SKIP_VALIDATE_ON_POWER_ON=n
CONFIG_BOOTLOADER_SKIP_VALIDATE_ALWAYS=n
CONFIG_SECURE_BOOT=n
CONFIG_SECURE_FLASH_ENC_ENABLED=n
```
